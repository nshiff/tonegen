
 
 #ifndef _Waveforms_h_
#define _Waveforms_h_

#define maxWaveform 4
#define maxSamplesNum 120

static int waveformsTable[maxWaveform][maxSamplesNum] = {
  // Sin wave
  {
    0x7f, 0x86, 0x8d, 0x93, 0x9a, 0xa1, 0xa7, 0xad, 0xb4, 0xba,
    0xbf, 0xc5, 0xcb, 0xd0, 0xd5, 0xda, 0xdf, 0xe3, 0xe7, 0xeb,
    0xee, 0xf1, 0xf4, 0xf7, 0xf9, 0xfb, 0xfd, 0xfe, 0xff, 0xff,
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    0x3f, 0x45, 0x4b, 0x52, 0x58, 0x5e, 0x65, 0x6b, 0x72, 0x79
  }
  ,

  // Triangular wave
  {
    0x44, 0x88, 0xcc, 0x11, 0x15, 0x19, 0x1d, 0x22, 0x26, 0x2a,
    0x2e, 0x33, 0x37, 0x3b, 0x3f, 0x44, 0x48, 0x4c, 0x50, 0x55,
    0x59, 0x5d, 0x61, 0x66, 0x6a, 0x6e, 0x72, 0x77, 0x7b, 0x7f,
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    0x26, 0x22, 0x1d, 0x19, 0x15, 0x11, 0xcc, 0x88, 0x44, 0x0
  }
  ,

  // Sawtooth wave
  {
    0x22, 0x44, 0x66, 0x88, 0xaa, 0xcc, 0xee, 0x110, 0x132, 0x154,
    0x176, 0x198, 0x1ba, 0x1dc, 0x1fe, 0x220, 0x242, 0x264, 0x286, 0x2a8,
    0x2ca, 0x2ec, 0x30e, 0x330, 0x352, 0x374, 0x396, 0x3b8, 0x3da, 0x3fc,
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    0xebe, 0xee0, 0xf02, 0xf24, 0xf46, 0xf68, 0xf8a, 0xfac, 0xfce, 0xff0
  }
  ,

  // Square wave
  {
    0xff, 0xff, 0xff, 0xff, 0xff, 0xff, 0xff, 0xff, 0xff, 0xff,
    0xff, 0xff, 0xff, 0xff, 0xff, 0xff, 0xff, 0xff, 0xff, 0xff,
    0xff, 0xff, 0xff, 0xff, 0xff, 0xff, 0xff, 0xff, 0xff, 0xff,
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    0x00, 0x00, 0x00, 0x00, 0x00, 0x00, 0x00, 0x00, 0x00, 0x00
  }

};

#endif 
 
 
 
//-------------------------------------------------------------
/*************************************************
 * Public Constants
 *************************************************/

#define NOTE_B0  31
#define NOTE_C1  33
#define NOTE_CS1 35
#define NOTE_D1  37
#define NOTE_DS1 39
#define NOTE_E1  41
#define NOTE_F1  44
#define NOTE_FS1 46
#define NOTE_G1  49
#define NOTE_GS1 52
#define NOTE_A1  55
#define NOTE_AS1 58
#define NOTE_B1  62
#define NOTE_C2  65
#define NOTE_CS2 69
#define NOTE_D2  73
#define NOTE_DS2 78
#define NOTE_E2  82
#define NOTE_F2  87
#define NOTE_FS2 93
#define NOTE_G2  98
#define NOTE_GS2 104
#define NOTE_A2  110
#define NOTE_AS2 117
#define NOTE_B2  123
#define NOTE_C3  131
#define NOTE_CS3 139
#define NOTE_D3  147
#define NOTE_DS3 156
#define NOTE_E3  165
#define NOTE_F3  175
#define NOTE_FS3 185
#define NOTE_G3  196
#define NOTE_GS3 208
#define NOTE_A3  220
#define NOTE_AS3 233
#define NOTE_B3  247
#define NOTE_C4  262
#define NOTE_CS4 277
#define NOTE_D4  294
#define NOTE_DS4 311
#define NOTE_E4  330
#define NOTE_F4  349
#define NOTE_FS4 370
#define NOTE_G4  392
#define NOTE_GS4 415
#define NOTE_A4  440
#define NOTE_AS4 466
#define NOTE_B4  494
#define NOTE_C5  513

//-------------------------------------------------------------

int pinAudioOut = 3;
int SECOND = 1000000; 	//in microseconds
int SINE		= 0;	//address in waveform table
int TRIANGLE 	= 1;
int SAWTOOTH 	= 2;
int SQUARE 		= 3;

void setup() {	/* === SETUP ===*/
	pinMode(pinAudioOut, OUTPUT);

	int melody[] = {NOTE_C4, NOTE_G3, NOTE_C2, NOTE_G3, NOTE_C4, NOTE_G4, NOTE_C5};

	for(int note; note<8; note++){	//8 notes in the melody
		playNCyclesPerSecond(melody[note]);
	}
	
}


void loop() {	/* === LOOP === */
	//save our sanity and play the melody only once
		
}

void playNCyclesPerSecond(int N){
	for(int i=0; i<N; i++){
		playOneWavelength(SQUARE, N);
	}
}

void playOneWavelength(int which, int frequency){
	
	for(int sample=0; sample<120; sample++){ //array is 120 elements long
		for(int freqStretch=0; freqStretch<(800/frequency); freqStretch++){	
			analogWrite(pinAudioOut, waveformsTable[which][sample]);
		}
	}
}
void rest(int duration){
	analogWrite(pinAudioOut, 0x00);
	usleep(duration);
}

void usleep(int n){
	delayMicroseconds(n);
}
